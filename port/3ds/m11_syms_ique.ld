/* GENERATED by port/3ds/tools/gen_link_syms.py -- do not edit */

PROVIDE(shim_guRotateF = guRotateF);
PROVIDE(shim_guTranslateF = guTranslateF);
PROVIDE(shim_guTranslate = guTranslate);
PROVIDE(shim_guScaleF = guScaleF);
PROVIDE(shim_guMtxCatF = guMtxCatF);
PROVIDE(shim_guMtxF2L = guMtxF2L);
PROVIDE(shim_guMtxL2F = guMtxL2F);
PROVIDE(shim_queue_render_task = queue_render_task);
PROVIDE(shim_create_effect_instance = create_effect_instance);
PROVIDE(shim_remove_effect = remove_effect);
PROVIDE(shim_general_heap_malloc = general_heap_malloc);
PROVIDE(shim_mem_clear = mem_clear);
PROVIDE(shim_rand_int = rand_int);
PROVIDE(shim_clamp_angle = clamp_angle);
PROVIDE(shim_sin_deg = sin_deg);
PROVIDE(shim_cos_deg = cos_deg);
PROVIDE(shim_atan2 = pm_atan2);
PROVIDE(shim_npc_raycast_down_sides = npc_raycast_down_sides);
PROVIDE(shim_load_effect = load_effect);
PROVIDE(shim_sqrtf = sqrtf);
PROVIDE(shim_mdl_draw_hidden_panel_surface = mdl_draw_hidden_panel_surface);
PROVIDE(shim_is_point_visible = is_point_visible);
PROVIDE(shim_guPerspectiveF = guPerspectiveF);
PROVIDE(shim_guMtxIdentF = guMtxIdentF);
PROVIDE(shim_transform_point = transform_point);
PROVIDE(shim_guLookAtHiliteF = guLookAtHiliteF);
PROVIDE(shim_set_screen_overlay_params_back = set_screen_overlay_params_back);
PROVIDE(shim_set_screen_overlay_center = set_screen_overlay_center);
PROVIDE(shim_set_screen_overlay_center_worldpos = set_screen_overlay_center_worldpos);
PROVIDE(shim_mdl_get_next_texture_address = mdl_get_next_texture_address);
PROVIDE(shim_guPositionF = guPositionF);
PROVIDE(shim_guOrthoF = guOrthoF);
PROVIDE(shim_guFrustumF = guFrustumF);
PROVIDE(shim_draw_prev_frame_buffer_at_screen_pos = draw_prev_frame_buffer_at_screen_pos);
PROVIDE(shim_draw_box = draw_box);
PROVIDE(shim_draw_msg = draw_msg);
PROVIDE(shim_get_msg_width = get_msg_width);
PROVIDE(shim_mdl_get_shroud_tint_params = mdl_get_shroud_tint_params);
PROVIDE(shim_sfx_play_sound_at_position = sfx_play_sound_at_position);

PROVIDE(dgb_01_smash_bridges_ROM_END = pm3ds_null_segment);
PROVIDE(dgb_01_smash_bridges_ROM_START = pm3ds_null_segment);
PROVIDE(dgb_01_smash_bridges_VRAM = pm3ds_null_segment);
PROVIDE(effect_attack_result_text_ROM_END = pm3ds_null_segment);
PROVIDE(effect_attack_result_text_ROM_START = pm3ds_null_segment);
PROVIDE(effect_attack_result_text_VRAM = pm3ds_null_segment);
PROVIDE(effect_aura_ROM_END = pm3ds_null_segment);
PROVIDE(effect_aura_ROM_START = pm3ds_null_segment);
PROVIDE(effect_aura_VRAM = pm3ds_null_segment);
PROVIDE(effect_balloon_ROM_END = pm3ds_null_segment);
PROVIDE(effect_balloon_ROM_START = pm3ds_null_segment);
PROVIDE(effect_balloon_VRAM = pm3ds_null_segment);
PROVIDE(effect_big_smoke_puff_ROM_END = pm3ds_null_segment);
PROVIDE(effect_big_smoke_puff_ROM_START = pm3ds_null_segment);
PROVIDE(effect_big_smoke_puff_VRAM = pm3ds_null_segment);
PROVIDE(effect_big_snowflakes_ROM_END = pm3ds_null_segment);
PROVIDE(effect_big_snowflakes_ROM_START = pm3ds_null_segment);
PROVIDE(effect_big_snowflakes_VRAM = pm3ds_null_segment);
PROVIDE(effect_blast_ROM_END = pm3ds_null_segment);
PROVIDE(effect_blast_ROM_START = pm3ds_null_segment);
PROVIDE(effect_blast_VRAM = pm3ds_null_segment);
PROVIDE(effect_bombette_breaking_ROM_END = pm3ds_null_segment);
PROVIDE(effect_bombette_breaking_ROM_START = pm3ds_null_segment);
PROVIDE(effect_bombette_breaking_VRAM = pm3ds_null_segment);
PROVIDE(effect_breaking_junk_ROM_END = pm3ds_null_segment);
PROVIDE(effect_breaking_junk_ROM_START = pm3ds_null_segment);
PROVIDE(effect_breaking_junk_VRAM = pm3ds_null_segment);
PROVIDE(effect_bulb_glow_ROM_END = pm3ds_null_segment);
PROVIDE(effect_bulb_glow_ROM_START = pm3ds_null_segment);
PROVIDE(effect_bulb_glow_VRAM = pm3ds_null_segment);
PROVIDE(effect_butterflies_ROM_END = pm3ds_null_segment);
PROVIDE(effect_butterflies_ROM_START = pm3ds_null_segment);
PROVIDE(effect_butterflies_VRAM = pm3ds_null_segment);
PROVIDE(effect_chapter_change_ROM_END = pm3ds_null_segment);
PROVIDE(effect_chapter_change_ROM_START = pm3ds_null_segment);
PROVIDE(effect_chapter_change_VRAM = pm3ds_null_segment);
PROVIDE(effect_chomp_drop_ROM_END = pm3ds_null_segment);
PROVIDE(effect_chomp_drop_ROM_START = pm3ds_null_segment);
PROVIDE(effect_chomp_drop_VRAM = pm3ds_null_segment);
PROVIDE(effect_cloud_puff_ROM_END = pm3ds_null_segment);
PROVIDE(effect_cloud_puff_ROM_START = pm3ds_null_segment);
PROVIDE(effect_cloud_puff_VRAM = pm3ds_null_segment);
PROVIDE(effect_cloud_trail_ROM_END = pm3ds_null_segment);
PROVIDE(effect_cloud_trail_ROM_START = pm3ds_null_segment);
PROVIDE(effect_cloud_trail_VRAM = pm3ds_null_segment);
PROVIDE(effect_cold_breath_ROM_END = pm3ds_null_segment);
PROVIDE(effect_cold_breath_ROM_START = pm3ds_null_segment);
PROVIDE(effect_cold_breath_VRAM = pm3ds_null_segment);
PROVIDE(effect_confetti_ROM_END = pm3ds_null_segment);
PROVIDE(effect_confetti_ROM_START = pm3ds_null_segment);
PROVIDE(effect_confetti_VRAM = pm3ds_null_segment);
PROVIDE(effect_damage_indicator_ROM_END = pm3ds_null_segment);
PROVIDE(effect_damage_indicator_ROM_START = pm3ds_null_segment);
PROVIDE(effect_damage_indicator_VRAM = pm3ds_null_segment);
PROVIDE(effect_damage_stars_ROM_END = pm3ds_null_segment);
PROVIDE(effect_damage_stars_ROM_START = pm3ds_null_segment);
PROVIDE(effect_damage_stars_VRAM = pm3ds_null_segment);
PROVIDE(effect_debuff_ROM_END = pm3ds_null_segment);
PROVIDE(effect_debuff_ROM_START = pm3ds_null_segment);
PROVIDE(effect_debuff_VRAM = pm3ds_null_segment);
PROVIDE(effect_disable_x_ROM_END = pm3ds_null_segment);
PROVIDE(effect_disable_x_ROM_START = pm3ds_null_segment);
PROVIDE(effect_disable_x_VRAM = pm3ds_null_segment);
PROVIDE(effect_drop_leaves_ROM_END = pm3ds_null_segment);
PROVIDE(effect_drop_leaves_ROM_START = pm3ds_null_segment);
PROVIDE(effect_drop_leaves_VRAM = pm3ds_null_segment);
PROVIDE(effect_dust_ROM_END = pm3ds_null_segment);
PROVIDE(effect_dust_ROM_START = pm3ds_null_segment);
PROVIDE(effect_dust_VRAM = pm3ds_null_segment);
PROVIDE(effect_effect_3D_ROM_END = pm3ds_null_segment);
PROVIDE(effect_effect_3D_ROM_START = pm3ds_null_segment);
PROVIDE(effect_effect_3D_VRAM = pm3ds_null_segment);
PROVIDE(effect_effect_46_ROM_END = pm3ds_null_segment);
PROVIDE(effect_effect_46_ROM_START = pm3ds_null_segment);
PROVIDE(effect_effect_46_VRAM = pm3ds_null_segment);
PROVIDE(effect_effect_63_ROM_END = pm3ds_null_segment);
PROVIDE(effect_effect_63_ROM_START = pm3ds_null_segment);
PROVIDE(effect_effect_63_VRAM = pm3ds_null_segment);
PROVIDE(effect_effect_65_ROM_END = pm3ds_null_segment);
PROVIDE(effect_effect_65_ROM_START = pm3ds_null_segment);
PROVIDE(effect_effect_65_VRAM = pm3ds_null_segment);
PROVIDE(effect_effect_75_ROM_END = pm3ds_null_segment);
PROVIDE(effect_effect_75_ROM_START = pm3ds_null_segment);
PROVIDE(effect_effect_75_VRAM = pm3ds_null_segment);
PROVIDE(effect_effect_86_ROM_END = pm3ds_null_segment);
PROVIDE(effect_effect_86_ROM_START = pm3ds_null_segment);
PROVIDE(effect_effect_86_VRAM = pm3ds_null_segment);
PROVIDE(effect_embers_ROM_END = pm3ds_null_segment);
PROVIDE(effect_embers_ROM_START = pm3ds_null_segment);
PROVIDE(effect_embers_VRAM = pm3ds_null_segment);
PROVIDE(effect_emote_ROM_END = pm3ds_null_segment);
PROVIDE(effect_emote_ROM_START = pm3ds_null_segment);
PROVIDE(effect_emote_VRAM = pm3ds_null_segment);
PROVIDE(effect_ending_decals_ROM_END = pm3ds_null_segment);
PROVIDE(effect_ending_decals_ROM_START = pm3ds_null_segment);
PROVIDE(effect_ending_decals_VRAM = pm3ds_null_segment);
PROVIDE(effect_energy_in_out_ROM_END = pm3ds_null_segment);
PROVIDE(effect_energy_in_out_ROM_START = pm3ds_null_segment);
PROVIDE(effect_energy_in_out_VRAM = pm3ds_null_segment);
PROVIDE(effect_energy_orb_wave_ROM_END = pm3ds_null_segment);
PROVIDE(effect_energy_orb_wave_ROM_START = pm3ds_null_segment);
PROVIDE(effect_energy_orb_wave_VRAM = pm3ds_null_segment);
PROVIDE(effect_energy_shockwave_ROM_END = pm3ds_null_segment);
PROVIDE(effect_energy_shockwave_ROM_START = pm3ds_null_segment);
PROVIDE(effect_energy_shockwave_VRAM = pm3ds_null_segment);
PROVIDE(effect_explosion_ROM_END = pm3ds_null_segment);
PROVIDE(effect_explosion_ROM_START = pm3ds_null_segment);
PROVIDE(effect_explosion_VRAM = pm3ds_null_segment);
PROVIDE(effect_falling_leaves_ROM_END = pm3ds_null_segment);
PROVIDE(effect_falling_leaves_ROM_START = pm3ds_null_segment);
PROVIDE(effect_falling_leaves_VRAM = pm3ds_null_segment);
PROVIDE(effect_fire_breath_ROM_END = pm3ds_null_segment);
PROVIDE(effect_fire_breath_ROM_START = pm3ds_null_segment);
PROVIDE(effect_fire_breath_VRAM = pm3ds_null_segment);
PROVIDE(effect_fire_flower_ROM_END = pm3ds_null_segment);
PROVIDE(effect_fire_flower_ROM_START = pm3ds_null_segment);
PROVIDE(effect_fire_flower_VRAM = pm3ds_null_segment);
PROVIDE(effect_firework_ROM_END = pm3ds_null_segment);
PROVIDE(effect_firework_ROM_START = pm3ds_null_segment);
PROVIDE(effect_firework_VRAM = pm3ds_null_segment);
PROVIDE(effect_firework_rocket_ROM_END = pm3ds_null_segment);
PROVIDE(effect_firework_rocket_ROM_START = pm3ds_null_segment);
PROVIDE(effect_firework_rocket_VRAM = pm3ds_null_segment);
PROVIDE(effect_flame_ROM_END = pm3ds_null_segment);
PROVIDE(effect_flame_ROM_START = pm3ds_null_segment);
PROVIDE(effect_flame_VRAM = pm3ds_null_segment);
PROVIDE(effect_flashing_box_shockwave_ROM_END = pm3ds_null_segment);
PROVIDE(effect_flashing_box_shockwave_ROM_START = pm3ds_null_segment);
PROVIDE(effect_flashing_box_shockwave_VRAM = pm3ds_null_segment);
PROVIDE(effect_floating_cloud_puff_ROM_END = pm3ds_null_segment);
PROVIDE(effect_floating_cloud_puff_ROM_START = pm3ds_null_segment);
PROVIDE(effect_floating_cloud_puff_VRAM = pm3ds_null_segment);
PROVIDE(effect_floating_flower_ROM_END = pm3ds_null_segment);
PROVIDE(effect_floating_flower_ROM_START = pm3ds_null_segment);
PROVIDE(effect_floating_flower_VRAM = pm3ds_null_segment);
PROVIDE(effect_floating_rock_ROM_END = pm3ds_null_segment);
PROVIDE(effect_floating_rock_ROM_START = pm3ds_null_segment);
PROVIDE(effect_floating_rock_VRAM = pm3ds_null_segment);
PROVIDE(effect_flower_splash_ROM_END = pm3ds_null_segment);
PROVIDE(effect_flower_splash_ROM_START = pm3ds_null_segment);
PROVIDE(effect_flower_splash_VRAM = pm3ds_null_segment);
PROVIDE(effect_flower_trail_ROM_END = pm3ds_null_segment);
PROVIDE(effect_flower_trail_ROM_START = pm3ds_null_segment);
PROVIDE(effect_flower_trail_VRAM = pm3ds_null_segment);
PROVIDE(effect_footprint_ROM_END = pm3ds_null_segment);
PROVIDE(effect_footprint_ROM_START = pm3ds_null_segment);
PROVIDE(effect_footprint_VRAM = pm3ds_null_segment);
PROVIDE(effect_fright_jar_ROM_END = pm3ds_null_segment);
PROVIDE(effect_fright_jar_ROM_START = pm3ds_null_segment);
PROVIDE(effect_fright_jar_VRAM = pm3ds_null_segment);
PROVIDE(effect_gather_energy_pink_ROM_END = pm3ds_null_segment);
PROVIDE(effect_gather_energy_pink_ROM_START = pm3ds_null_segment);
PROVIDE(effect_gather_energy_pink_VRAM = pm3ds_null_segment);
PROVIDE(effect_gather_magic_ROM_END = pm3ds_null_segment);
PROVIDE(effect_gather_magic_ROM_START = pm3ds_null_segment);
PROVIDE(effect_gather_magic_VRAM = pm3ds_null_segment);
PROVIDE(effect_gfx_attack_result_text_ROM_END = pm3ds_null_segment);
PROVIDE(effect_gfx_attack_result_text_ROM_START = pm3ds_null_segment);
PROVIDE(effect_gfx_aura_ROM_END = pm3ds_null_segment);
PROVIDE(effect_gfx_aura_ROM_START = pm3ds_null_segment);
PROVIDE(effect_gfx_balloon_ROM_END = pm3ds_null_segment);
PROVIDE(effect_gfx_balloon_ROM_START = pm3ds_null_segment);
PROVIDE(effect_gfx_big_smoke_puff_ROM_END = pm3ds_null_segment);
PROVIDE(effect_gfx_big_smoke_puff_ROM_START = pm3ds_null_segment);
PROVIDE(effect_gfx_big_snowflakes_ROM_END = pm3ds_null_segment);
PROVIDE(effect_gfx_big_snowflakes_ROM_START = pm3ds_null_segment);
PROVIDE(effect_gfx_blast_ROM_END = pm3ds_null_segment);
PROVIDE(effect_gfx_blast_ROM_START = pm3ds_null_segment);
PROVIDE(effect_gfx_breaking_junk_ROM_END = pm3ds_null_segment);
PROVIDE(effect_gfx_breaking_junk_ROM_START = pm3ds_null_segment);
PROVIDE(effect_gfx_bulb_glow_ROM_END = pm3ds_null_segment);
PROVIDE(effect_gfx_bulb_glow_ROM_START = pm3ds_null_segment);
PROVIDE(effect_gfx_butterflies_ROM_END = pm3ds_null_segment);
PROVIDE(effect_gfx_butterflies_ROM_START = pm3ds_null_segment);
PROVIDE(effect_gfx_chapter_change_ROM_END = pm3ds_null_segment);
PROVIDE(effect_gfx_chapter_change_ROM_START = pm3ds_null_segment);
PROVIDE(effect_gfx_chomp_drop_ROM_END = pm3ds_null_segment);
PROVIDE(effect_gfx_chomp_drop_ROM_START = pm3ds_null_segment);
PROVIDE(effect_gfx_cloud_puff_trail_ROM_END = pm3ds_null_segment);
PROVIDE(effect_gfx_cloud_puff_trail_ROM_START = pm3ds_null_segment);
PROVIDE(effect_gfx_cold_breath_ROM_END = pm3ds_null_segment);
PROVIDE(effect_gfx_cold_breath_ROM_START = pm3ds_null_segment);
PROVIDE(effect_gfx_confetti_ROM_END = pm3ds_null_segment);
PROVIDE(effect_gfx_confetti_ROM_START = pm3ds_null_segment);
PROVIDE(effect_gfx_damage_indicator_ROM_END = pm3ds_null_segment);
PROVIDE(effect_gfx_damage_indicator_ROM_START = pm3ds_null_segment);
PROVIDE(effect_gfx_damage_stars_ROM_END = pm3ds_null_segment);
PROVIDE(effect_gfx_damage_stars_ROM_START = pm3ds_null_segment);
PROVIDE(effect_gfx_debuff_ROM_END = pm3ds_null_segment);
PROVIDE(effect_gfx_debuff_ROM_START = pm3ds_null_segment);
PROVIDE(effect_gfx_disable_x_ROM_END = pm3ds_null_segment);
PROVIDE(effect_gfx_disable_x_ROM_START = pm3ds_null_segment);
PROVIDE(effect_gfx_drop_leaves_ROM_END = pm3ds_null_segment);
PROVIDE(effect_gfx_drop_leaves_ROM_START = pm3ds_null_segment);
PROVIDE(effect_gfx_dust_ROM_END = pm3ds_null_segment);
PROVIDE(effect_gfx_dust_ROM_START = pm3ds_null_segment);
PROVIDE(effect_gfx_effect_3D_ROM_END = pm3ds_null_segment);
PROVIDE(effect_gfx_effect_3D_ROM_START = pm3ds_null_segment);
PROVIDE(effect_gfx_effect_46_ROM_END = pm3ds_null_segment);
PROVIDE(effect_gfx_effect_46_ROM_START = pm3ds_null_segment);
PROVIDE(effect_gfx_effect_63_ROM_END = pm3ds_null_segment);
PROVIDE(effect_gfx_effect_63_ROM_START = pm3ds_null_segment);
PROVIDE(effect_gfx_effect_65_ROM_END = pm3ds_null_segment);
PROVIDE(effect_gfx_effect_65_ROM_START = pm3ds_null_segment);
PROVIDE(effect_gfx_effect_75_ROM_END = pm3ds_null_segment);
PROVIDE(effect_gfx_effect_75_ROM_START = pm3ds_null_segment);
PROVIDE(effect_gfx_effect_86_ROM_END = pm3ds_null_segment);
PROVIDE(effect_gfx_effect_86_ROM_START = pm3ds_null_segment);
PROVIDE(effect_gfx_embers_ROM_END = pm3ds_null_segment);
PROVIDE(effect_gfx_embers_ROM_START = pm3ds_null_segment);
PROVIDE(effect_gfx_emote_ROM_END = pm3ds_null_segment);
PROVIDE(effect_gfx_emote_ROM_START = pm3ds_null_segment);
PROVIDE(effect_gfx_ending_decals_ROM_END = pm3ds_null_segment);
PROVIDE(effect_gfx_ending_decals_ROM_START = pm3ds_null_segment);
PROVIDE(effect_gfx_energy_in_out_ROM_END = pm3ds_null_segment);
PROVIDE(effect_gfx_energy_in_out_ROM_START = pm3ds_null_segment);
PROVIDE(effect_gfx_energy_orb_wave_ROM_END = pm3ds_null_segment);
PROVIDE(effect_gfx_energy_orb_wave_ROM_START = pm3ds_null_segment);
PROVIDE(effect_gfx_energy_shockwave_ROM_END = pm3ds_null_segment);
PROVIDE(effect_gfx_energy_shockwave_ROM_START = pm3ds_null_segment);
PROVIDE(effect_gfx_explosion_ROM_END = pm3ds_null_segment);
PROVIDE(effect_gfx_explosion_ROM_START = pm3ds_null_segment);
PROVIDE(effect_gfx_falling_leaves_ROM_END = pm3ds_null_segment);
PROVIDE(effect_gfx_falling_leaves_ROM_START = pm3ds_null_segment);
PROVIDE(effect_gfx_fire_breath_ROM_END = pm3ds_null_segment);
PROVIDE(effect_gfx_fire_breath_ROM_START = pm3ds_null_segment);
PROVIDE(effect_gfx_fire_flower_ROM_END = pm3ds_null_segment);
PROVIDE(effect_gfx_fire_flower_ROM_START = pm3ds_null_segment);
PROVIDE(effect_gfx_firework_ROM_END = pm3ds_null_segment);
PROVIDE(effect_gfx_firework_ROM_START = pm3ds_null_segment);
PROVIDE(effect_gfx_firework_rocket_ROM_END = pm3ds_null_segment);
PROVIDE(effect_gfx_firework_rocket_ROM_START = pm3ds_null_segment);
PROVIDE(effect_gfx_flame_ROM_END = pm3ds_null_segment);
PROVIDE(effect_gfx_flame_ROM_START = pm3ds_null_segment);
PROVIDE(effect_gfx_flashing_box_shockwave_ROM_END = pm3ds_null_segment);
PROVIDE(effect_gfx_flashing_box_shockwave_ROM_START = pm3ds_null_segment);
PROVIDE(effect_gfx_floating_cloud_puff_ROM_END = pm3ds_null_segment);
PROVIDE(effect_gfx_floating_cloud_puff_ROM_START = pm3ds_null_segment);
PROVIDE(effect_gfx_floating_flower_ROM_END = pm3ds_null_segment);
PROVIDE(effect_gfx_floating_flower_ROM_START = pm3ds_null_segment);
PROVIDE(effect_gfx_floating_rock_ROM_END = pm3ds_null_segment);
PROVIDE(effect_gfx_floating_rock_ROM_START = pm3ds_null_segment);
PROVIDE(effect_gfx_flower_splash_trail_ROM_END = pm3ds_null_segment);
PROVIDE(effect_gfx_flower_splash_trail_ROM_START = pm3ds_null_segment);
PROVIDE(effect_gfx_footprint_ROM_END = pm3ds_null_segment);
PROVIDE(effect_gfx_footprint_ROM_START = pm3ds_null_segment);
PROVIDE(effect_gfx_fright_jar_ROM_END = pm3ds_null_segment);
PROVIDE(effect_gfx_fright_jar_ROM_START = pm3ds_null_segment);
PROVIDE(effect_gfx_gather_energy_pink_ROM_END = pm3ds_null_segment);
PROVIDE(effect_gfx_gather_energy_pink_ROM_START = pm3ds_null_segment);
PROVIDE(effect_gfx_gather_magic_ROM_END = pm3ds_null_segment);
PROVIDE(effect_gfx_gather_magic_ROM_START = pm3ds_null_segment);
PROVIDE(effect_gfx_got_item_outline_ROM_END = pm3ds_null_segment);
PROVIDE(effect_gfx_got_item_outline_ROM_START = pm3ds_null_segment);
PROVIDE(effect_gfx_green_impact_ROM_END = pm3ds_null_segment);
PROVIDE(effect_gfx_green_impact_ROM_START = pm3ds_null_segment);
PROVIDE(effect_gfx_hieroglyphs_ROM_END = pm3ds_null_segment);
PROVIDE(effect_gfx_hieroglyphs_ROM_START = pm3ds_null_segment);
PROVIDE(effect_gfx_huff_puff_breath_ROM_END = pm3ds_null_segment);
PROVIDE(effect_gfx_huff_puff_breath_ROM_START = pm3ds_null_segment);
PROVIDE(effect_gfx_ice_pillar_ROM_END = pm3ds_null_segment);
PROVIDE(effect_gfx_ice_pillar_ROM_START = pm3ds_null_segment);
PROVIDE(effect_gfx_ice_shard_ROM_END = pm3ds_null_segment);
PROVIDE(effect_gfx_ice_shard_ROM_START = pm3ds_null_segment);
PROVIDE(effect_gfx_landing_dust_ROM_END = pm3ds_null_segment);
PROVIDE(effect_gfx_landing_dust_ROM_START = pm3ds_null_segment);
PROVIDE(effect_gfx_lens_flare_ROM_END = pm3ds_null_segment);
PROVIDE(effect_gfx_lens_flare_ROM_START = pm3ds_null_segment);
PROVIDE(effect_gfx_light_rays_ROM_END = pm3ds_null_segment);
PROVIDE(effect_gfx_light_rays_ROM_START = pm3ds_null_segment);
PROVIDE(effect_gfx_lightning_ROM_END = pm3ds_null_segment);
PROVIDE(effect_gfx_lightning_ROM_START = pm3ds_null_segment);
PROVIDE(effect_gfx_lightning_bolt_ROM_END = pm3ds_null_segment);
PROVIDE(effect_gfx_lightning_bolt_ROM_START = pm3ds_null_segment);
PROVIDE(effect_gfx_lil_oink_ROM_END = pm3ds_null_segment);
PROVIDE(effect_gfx_lil_oink_ROM_START = pm3ds_null_segment);
PROVIDE(effect_gfx_merlin_house_stars_ROM_END = pm3ds_null_segment);
PROVIDE(effect_gfx_merlin_house_stars_ROM_START = pm3ds_null_segment);
PROVIDE(effect_gfx_misc_particles_ROM_END = pm3ds_null_segment);
PROVIDE(effect_gfx_misc_particles_ROM_START = pm3ds_null_segment);
PROVIDE(effect_gfx_motion_blur_flame_ROM_END = pm3ds_null_segment);
PROVIDE(effect_gfx_motion_blur_flame_ROM_START = pm3ds_null_segment);
PROVIDE(effect_gfx_moving_cloud_ROM_END = pm3ds_null_segment);
PROVIDE(effect_gfx_moving_cloud_ROM_START = pm3ds_null_segment);
PROVIDE(effect_gfx_music_note_ROM_END = pm3ds_null_segment);
PROVIDE(effect_gfx_music_note_ROM_START = pm3ds_null_segment);
PROVIDE(effect_gfx_partner_buff_ROM_END = pm3ds_null_segment);
PROVIDE(effect_gfx_partner_buff_ROM_START = pm3ds_null_segment);
PROVIDE(effect_gfx_peach_star_beam_ROM_END = pm3ds_null_segment);
PROVIDE(effect_gfx_peach_star_beam_ROM_START = pm3ds_null_segment);
PROVIDE(effect_gfx_purple_ring_ROM_END = pm3ds_null_segment);
PROVIDE(effect_gfx_purple_ring_ROM_START = pm3ds_null_segment);
PROVIDE(effect_gfx_quizmo_answer_ROM_END = pm3ds_null_segment);
PROVIDE(effect_gfx_quizmo_answer_ROM_START = pm3ds_null_segment);
PROVIDE(effect_gfx_quizmo_assistant_ROM_END = pm3ds_null_segment);
PROVIDE(effect_gfx_quizmo_assistant_ROM_START = pm3ds_null_segment);
PROVIDE(effect_gfx_quizmo_audience_ROM_END = pm3ds_null_segment);
PROVIDE(effect_gfx_quizmo_audience_ROM_START = pm3ds_null_segment);
PROVIDE(effect_gfx_quizmo_stage_ROM_END = pm3ds_null_segment);
PROVIDE(effect_gfx_quizmo_stage_ROM_START = pm3ds_null_segment);
PROVIDE(effect_gfx_radial_shimmer_ROM_END = pm3ds_null_segment);
PROVIDE(effect_gfx_radial_shimmer_ROM_START = pm3ds_null_segment);
PROVIDE(effect_gfx_radiating_energy_orb_ROM_END = pm3ds_null_segment);
PROVIDE(effect_gfx_radiating_energy_orb_ROM_START = pm3ds_null_segment);
PROVIDE(effect_gfx_recover_ROM_END = pm3ds_null_segment);
PROVIDE(effect_gfx_recover_ROM_START = pm3ds_null_segment);
PROVIDE(effect_gfx_ring_blast_ROM_END = pm3ds_null_segment);
PROVIDE(effect_gfx_ring_blast_ROM_START = pm3ds_null_segment);
PROVIDE(effect_gfx_rising_bubble_ROM_END = pm3ds_null_segment);
PROVIDE(effect_gfx_rising_bubble_ROM_START = pm3ds_null_segment);
PROVIDE(effect_gfx_shape_spell_ROM_END = pm3ds_null_segment);
PROVIDE(effect_gfx_shape_spell_ROM_START = pm3ds_null_segment);
PROVIDE(effect_gfx_shattering_stones_ROM_END = pm3ds_null_segment);
PROVIDE(effect_gfx_shattering_stones_ROM_START = pm3ds_null_segment);
PROVIDE(effect_gfx_shiny_flare_ROM_END = pm3ds_null_segment);
PROVIDE(effect_gfx_shiny_flare_ROM_START = pm3ds_null_segment);
PROVIDE(effect_gfx_shockwave_ROM_END = pm3ds_null_segment);
PROVIDE(effect_gfx_shockwave_ROM_START = pm3ds_null_segment);
PROVIDE(effect_gfx_sleep_bubble_ROM_END = pm3ds_null_segment);
PROVIDE(effect_gfx_sleep_bubble_ROM_START = pm3ds_null_segment);
PROVIDE(effect_gfx_small_gold_sparkle_ROM_END = pm3ds_null_segment);
PROVIDE(effect_gfx_small_gold_sparkle_ROM_START = pm3ds_null_segment);
PROVIDE(effect_gfx_snaking_static_ROM_END = pm3ds_null_segment);
PROVIDE(effect_gfx_snaking_static_ROM_START = pm3ds_null_segment);
PROVIDE(effect_gfx_snowfall_ROM_END = pm3ds_null_segment);
PROVIDE(effect_gfx_snowfall_ROM_START = pm3ds_null_segment);
PROVIDE(effect_gfx_snowflake_ROM_END = pm3ds_null_segment);
PROVIDE(effect_gfx_snowflake_ROM_START = pm3ds_null_segment);
PROVIDE(effect_gfx_snowman_doll_ROM_END = pm3ds_null_segment);
PROVIDE(effect_gfx_snowman_doll_ROM_START = pm3ds_null_segment);
PROVIDE(effect_gfx_sparkles_ROM_END = pm3ds_null_segment);
PROVIDE(effect_gfx_sparkles_ROM_START = pm3ds_null_segment);
PROVIDE(effect_gfx_spiky_white_aura_ROM_END = pm3ds_null_segment);
PROVIDE(effect_gfx_spiky_white_aura_ROM_START = pm3ds_null_segment);
PROVIDE(effect_gfx_spirit_card_ROM_END = pm3ds_null_segment);
PROVIDE(effect_gfx_spirit_card_ROM_START = pm3ds_null_segment);
PROVIDE(effect_gfx_squirt_ROM_END = pm3ds_null_segment);
PROVIDE(effect_gfx_squirt_ROM_START = pm3ds_null_segment);
PROVIDE(effect_gfx_star_ROM_END = pm3ds_null_segment);
PROVIDE(effect_gfx_star_ROM_START = pm3ds_null_segment);
PROVIDE(effect_gfx_star_outline_ROM_END = pm3ds_null_segment);
PROVIDE(effect_gfx_star_outline_ROM_START = pm3ds_null_segment);
PROVIDE(effect_gfx_star_spirits_energy_ROM_END = pm3ds_null_segment);
PROVIDE(effect_gfx_star_spirits_energy_ROM_START = pm3ds_null_segment);
PROVIDE(effect_gfx_stars_orbiting_ROM_END = pm3ds_null_segment);
PROVIDE(effect_gfx_stars_orbiting_ROM_START = pm3ds_null_segment);
PROVIDE(effect_gfx_stars_spread_ROM_END = pm3ds_null_segment);
PROVIDE(effect_gfx_stars_spread_ROM_START = pm3ds_null_segment);
PROVIDE(effect_gfx_stat_change_ROM_END = pm3ds_null_segment);
PROVIDE(effect_gfx_stat_change_ROM_START = pm3ds_null_segment);
PROVIDE(effect_gfx_static_status_ROM_END = pm3ds_null_segment);
PROVIDE(effect_gfx_static_status_ROM_START = pm3ds_null_segment);
PROVIDE(effect_gfx_steam_burst_ROM_END = pm3ds_null_segment);
PROVIDE(effect_gfx_steam_burst_ROM_START = pm3ds_null_segment);
PROVIDE(effect_gfx_stop_watch_ROM_END = pm3ds_null_segment);
PROVIDE(effect_gfx_stop_watch_ROM_START = pm3ds_null_segment);
PROVIDE(effect_gfx_sun_ROM_END = pm3ds_null_segment);
PROVIDE(effect_gfx_sun_ROM_START = pm3ds_null_segment);
PROVIDE(effect_gfx_sweat_ROM_END = pm3ds_null_segment);
PROVIDE(effect_gfx_sweat_ROM_START = pm3ds_null_segment);
PROVIDE(effect_gfx_tattle_window_ROM_END = pm3ds_null_segment);
PROVIDE(effect_gfx_tattle_window_ROM_START = pm3ds_null_segment);
PROVIDE(effect_gfx_throw_spiny_ROM_END = pm3ds_null_segment);
PROVIDE(effect_gfx_throw_spiny_ROM_START = pm3ds_null_segment);
PROVIDE(effect_gfx_thunderbolt_ring_ROM_END = pm3ds_null_segment);
PROVIDE(effect_gfx_thunderbolt_ring_ROM_START = pm3ds_null_segment);
PROVIDE(effect_gfx_tubba_heart_attack_ROM_END = pm3ds_null_segment);
PROVIDE(effect_gfx_tubba_heart_attack_ROM_START = pm3ds_null_segment);
PROVIDE(effect_gfx_underwater_ROM_END = pm3ds_null_segment);
PROVIDE(effect_gfx_underwater_ROM_START = pm3ds_null_segment);
PROVIDE(effect_gfx_water_block_ROM_END = pm3ds_null_segment);
PROVIDE(effect_gfx_water_block_ROM_START = pm3ds_null_segment);
PROVIDE(effect_gfx_water_fountain_ROM_END = pm3ds_null_segment);
PROVIDE(effect_gfx_water_fountain_ROM_START = pm3ds_null_segment);
PROVIDE(effect_gfx_water_splash_ROM_END = pm3ds_null_segment);
PROVIDE(effect_gfx_water_splash_ROM_START = pm3ds_null_segment);
PROVIDE(effect_gfx_waterfall_ROM_END = pm3ds_null_segment);
PROVIDE(effect_gfx_waterfall_ROM_START = pm3ds_null_segment);
PROVIDE(effect_gfx_whirlwind_ROM_END = pm3ds_null_segment);
PROVIDE(effect_gfx_whirlwind_ROM_START = pm3ds_null_segment);
PROVIDE(effect_got_item_outline_ROM_END = pm3ds_null_segment);
PROVIDE(effect_got_item_outline_ROM_START = pm3ds_null_segment);
PROVIDE(effect_got_item_outline_VRAM = pm3ds_null_segment);
PROVIDE(effect_green_impact_ROM_END = pm3ds_null_segment);
PROVIDE(effect_green_impact_ROM_START = pm3ds_null_segment);
PROVIDE(effect_green_impact_VRAM = pm3ds_null_segment);
PROVIDE(effect_hieroglyphs_ROM_END = pm3ds_null_segment);
PROVIDE(effect_hieroglyphs_ROM_START = pm3ds_null_segment);
PROVIDE(effect_hieroglyphs_VRAM = pm3ds_null_segment);
PROVIDE(effect_huff_puff_breath_ROM_END = pm3ds_null_segment);
PROVIDE(effect_huff_puff_breath_ROM_START = pm3ds_null_segment);
PROVIDE(effect_huff_puff_breath_VRAM = pm3ds_null_segment);
PROVIDE(effect_ice_pillar_ROM_END = pm3ds_null_segment);
PROVIDE(effect_ice_pillar_ROM_START = pm3ds_null_segment);
PROVIDE(effect_ice_pillar_VRAM = pm3ds_null_segment);
PROVIDE(effect_ice_shard_ROM_END = pm3ds_null_segment);
PROVIDE(effect_ice_shard_ROM_START = pm3ds_null_segment);
PROVIDE(effect_ice_shard_VRAM = pm3ds_null_segment);
PROVIDE(effect_landing_dust_ROM_END = pm3ds_null_segment);
PROVIDE(effect_landing_dust_ROM_START = pm3ds_null_segment);
PROVIDE(effect_landing_dust_VRAM = pm3ds_null_segment);
PROVIDE(effect_lens_flare_ROM_END = pm3ds_null_segment);
PROVIDE(effect_lens_flare_ROM_START = pm3ds_null_segment);
PROVIDE(effect_lens_flare_VRAM = pm3ds_null_segment);
PROVIDE(effect_light_rays_ROM_END = pm3ds_null_segment);
PROVIDE(effect_light_rays_ROM_START = pm3ds_null_segment);
PROVIDE(effect_light_rays_VRAM = pm3ds_null_segment);
PROVIDE(effect_lightning_ROM_END = pm3ds_null_segment);
PROVIDE(effect_lightning_ROM_START = pm3ds_null_segment);
PROVIDE(effect_lightning_VRAM = pm3ds_null_segment);
PROVIDE(effect_lightning_bolt_ROM_END = pm3ds_null_segment);
PROVIDE(effect_lightning_bolt_ROM_START = pm3ds_null_segment);
PROVIDE(effect_lightning_bolt_VRAM = pm3ds_null_segment);
PROVIDE(effect_lil_oink_ROM_END = pm3ds_null_segment);
PROVIDE(effect_lil_oink_ROM_START = pm3ds_null_segment);
PROVIDE(effect_lil_oink_VRAM = pm3ds_null_segment);
PROVIDE(effect_merlin_house_stars_ROM_END = pm3ds_null_segment);
PROVIDE(effect_merlin_house_stars_ROM_START = pm3ds_null_segment);
PROVIDE(effect_merlin_house_stars_VRAM = pm3ds_null_segment);
PROVIDE(effect_misc_particles_ROM_END = pm3ds_null_segment);
PROVIDE(effect_misc_particles_ROM_START = pm3ds_null_segment);
PROVIDE(effect_misc_particles_VRAM = pm3ds_null_segment);
PROVIDE(effect_motion_blur_flame_ROM_END = pm3ds_null_segment);
PROVIDE(effect_motion_blur_flame_ROM_START = pm3ds_null_segment);
PROVIDE(effect_motion_blur_flame_VRAM = pm3ds_null_segment);
PROVIDE(effect_moving_cloud_ROM_END = pm3ds_null_segment);
PROVIDE(effect_moving_cloud_ROM_START = pm3ds_null_segment);
PROVIDE(effect_moving_cloud_VRAM = pm3ds_null_segment);
PROVIDE(effect_music_note_ROM_END = pm3ds_null_segment);
PROVIDE(effect_music_note_ROM_START = pm3ds_null_segment);
PROVIDE(effect_music_note_VRAM = pm3ds_null_segment);
PROVIDE(effect_partner_buff_ROM_END = pm3ds_null_segment);
PROVIDE(effect_partner_buff_ROM_START = pm3ds_null_segment);
PROVIDE(effect_partner_buff_VRAM = pm3ds_null_segment);
PROVIDE(effect_peach_star_beam_ROM_END = pm3ds_null_segment);
PROVIDE(effect_peach_star_beam_ROM_START = pm3ds_null_segment);
PROVIDE(effect_peach_star_beam_VRAM = pm3ds_null_segment);
PROVIDE(effect_pink_sparkles_ROM_END = pm3ds_null_segment);
PROVIDE(effect_pink_sparkles_ROM_START = pm3ds_null_segment);
PROVIDE(effect_pink_sparkles_VRAM = pm3ds_null_segment);
PROVIDE(effect_purple_ring_ROM_END = pm3ds_null_segment);
PROVIDE(effect_purple_ring_ROM_START = pm3ds_null_segment);
PROVIDE(effect_purple_ring_VRAM = pm3ds_null_segment);
PROVIDE(effect_quizmo_answer_ROM_END = pm3ds_null_segment);
PROVIDE(effect_quizmo_answer_ROM_START = pm3ds_null_segment);
PROVIDE(effect_quizmo_answer_VRAM = pm3ds_null_segment);
PROVIDE(effect_quizmo_assistant_ROM_END = pm3ds_null_segment);
PROVIDE(effect_quizmo_assistant_ROM_START = pm3ds_null_segment);
PROVIDE(effect_quizmo_assistant_VRAM = pm3ds_null_segment);
PROVIDE(effect_quizmo_audience_ROM_END = pm3ds_null_segment);
PROVIDE(effect_quizmo_audience_ROM_START = pm3ds_null_segment);
PROVIDE(effect_quizmo_audience_VRAM = pm3ds_null_segment);
PROVIDE(effect_quizmo_stage_ROM_END = pm3ds_null_segment);
PROVIDE(effect_quizmo_stage_ROM_START = pm3ds_null_segment);
PROVIDE(effect_quizmo_stage_VRAM = pm3ds_null_segment);
PROVIDE(effect_radial_shimmer_ROM_END = pm3ds_null_segment);
PROVIDE(effect_radial_shimmer_ROM_START = pm3ds_null_segment);
PROVIDE(effect_radial_shimmer_VRAM = pm3ds_null_segment);
PROVIDE(effect_radiating_energy_orb_ROM_END = pm3ds_null_segment);
PROVIDE(effect_radiating_energy_orb_ROM_START = pm3ds_null_segment);
PROVIDE(effect_radiating_energy_orb_VRAM = pm3ds_null_segment);
PROVIDE(effect_recover_ROM_END = pm3ds_null_segment);
PROVIDE(effect_recover_ROM_START = pm3ds_null_segment);
PROVIDE(effect_recover_VRAM = pm3ds_null_segment);
PROVIDE(effect_red_impact_ROM_END = pm3ds_null_segment);
PROVIDE(effect_red_impact_ROM_START = pm3ds_null_segment);
PROVIDE(effect_red_impact_VRAM = pm3ds_null_segment);
PROVIDE(effect_ring_blast_ROM_END = pm3ds_null_segment);
PROVIDE(effect_ring_blast_ROM_START = pm3ds_null_segment);
PROVIDE(effect_ring_blast_VRAM = pm3ds_null_segment);
PROVIDE(effect_rising_bubble_ROM_END = pm3ds_null_segment);
PROVIDE(effect_rising_bubble_ROM_START = pm3ds_null_segment);
PROVIDE(effect_rising_bubble_VRAM = pm3ds_null_segment);
PROVIDE(effect_shape_spell_ROM_END = pm3ds_null_segment);
PROVIDE(effect_shape_spell_ROM_START = pm3ds_null_segment);
PROVIDE(effect_shape_spell_VRAM = pm3ds_null_segment);
PROVIDE(effect_shattering_stones_ROM_END = pm3ds_null_segment);
PROVIDE(effect_shattering_stones_ROM_START = pm3ds_null_segment);
PROVIDE(effect_shattering_stones_VRAM = pm3ds_null_segment);
PROVIDE(effect_shimmer_burst_ROM_END = pm3ds_null_segment);
PROVIDE(effect_shimmer_burst_ROM_START = pm3ds_null_segment);
PROVIDE(effect_shimmer_burst_VRAM = pm3ds_null_segment);
PROVIDE(effect_shimmer_wave_ROM_END = pm3ds_null_segment);
PROVIDE(effect_shimmer_wave_ROM_START = pm3ds_null_segment);
PROVIDE(effect_shimmer_wave_VRAM = pm3ds_null_segment);
PROVIDE(effect_shiny_flare_ROM_END = pm3ds_null_segment);
PROVIDE(effect_shiny_flare_ROM_START = pm3ds_null_segment);
PROVIDE(effect_shiny_flare_VRAM = pm3ds_null_segment);
PROVIDE(effect_shockwave_ROM_END = pm3ds_null_segment);
PROVIDE(effect_shockwave_ROM_START = pm3ds_null_segment);
PROVIDE(effect_shockwave_VRAM = pm3ds_null_segment);
PROVIDE(effect_sleep_bubble_ROM_END = pm3ds_null_segment);
PROVIDE(effect_sleep_bubble_ROM_START = pm3ds_null_segment);
PROVIDE(effect_sleep_bubble_VRAM = pm3ds_null_segment);
PROVIDE(effect_small_gold_sparkle_ROM_END = pm3ds_null_segment);
PROVIDE(effect_small_gold_sparkle_ROM_START = pm3ds_null_segment);
PROVIDE(effect_small_gold_sparkle_VRAM = pm3ds_null_segment);
PROVIDE(effect_smoke_burst_ROM_END = pm3ds_null_segment);
PROVIDE(effect_smoke_burst_ROM_START = pm3ds_null_segment);
PROVIDE(effect_smoke_burst_VRAM = pm3ds_null_segment);
PROVIDE(effect_smoke_impact_ROM_END = pm3ds_null_segment);
PROVIDE(effect_smoke_impact_ROM_START = pm3ds_null_segment);
PROVIDE(effect_smoke_impact_VRAM = pm3ds_null_segment);
PROVIDE(effect_smoke_ring_ROM_END = pm3ds_null_segment);
PROVIDE(effect_smoke_ring_ROM_START = pm3ds_null_segment);
PROVIDE(effect_smoke_ring_VRAM = pm3ds_null_segment);
PROVIDE(effect_snaking_static_ROM_END = pm3ds_null_segment);
PROVIDE(effect_snaking_static_ROM_START = pm3ds_null_segment);
PROVIDE(effect_snaking_static_VRAM = pm3ds_null_segment);
PROVIDE(effect_snowfall_ROM_END = pm3ds_null_segment);
PROVIDE(effect_snowfall_ROM_START = pm3ds_null_segment);
PROVIDE(effect_snowfall_VRAM = pm3ds_null_segment);
PROVIDE(effect_snowflake_ROM_END = pm3ds_null_segment);
PROVIDE(effect_snowflake_ROM_START = pm3ds_null_segment);
PROVIDE(effect_snowflake_VRAM = pm3ds_null_segment);
PROVIDE(effect_snowman_doll_ROM_END = pm3ds_null_segment);
PROVIDE(effect_snowman_doll_ROM_START = pm3ds_null_segment);
PROVIDE(effect_snowman_doll_VRAM = pm3ds_null_segment);
PROVIDE(effect_something_rotating_ROM_END = pm3ds_null_segment);
PROVIDE(effect_something_rotating_ROM_START = pm3ds_null_segment);
PROVIDE(effect_something_rotating_VRAM = pm3ds_null_segment);
PROVIDE(effect_sparkles_ROM_END = pm3ds_null_segment);
PROVIDE(effect_sparkles_ROM_START = pm3ds_null_segment);
PROVIDE(effect_sparkles_VRAM = pm3ds_null_segment);
PROVIDE(effect_spiky_white_aura_ROM_END = pm3ds_null_segment);
PROVIDE(effect_spiky_white_aura_ROM_START = pm3ds_null_segment);
PROVIDE(effect_spiky_white_aura_VRAM = pm3ds_null_segment);
PROVIDE(effect_spirit_card_ROM_END = pm3ds_null_segment);
PROVIDE(effect_spirit_card_ROM_START = pm3ds_null_segment);
PROVIDE(effect_spirit_card_VRAM = pm3ds_null_segment);
PROVIDE(effect_squirt_ROM_END = pm3ds_null_segment);
PROVIDE(effect_squirt_ROM_START = pm3ds_null_segment);
PROVIDE(effect_squirt_VRAM = pm3ds_null_segment);
PROVIDE(effect_star_ROM_END = pm3ds_null_segment);
PROVIDE(effect_star_ROM_START = pm3ds_null_segment);
PROVIDE(effect_star_VRAM = pm3ds_null_segment);
PROVIDE(effect_star_outline_ROM_END = pm3ds_null_segment);
PROVIDE(effect_star_outline_ROM_START = pm3ds_null_segment);
PROVIDE(effect_star_outline_VRAM = pm3ds_null_segment);
PROVIDE(effect_star_spirits_energy_ROM_END = pm3ds_null_segment);
PROVIDE(effect_star_spirits_energy_ROM_START = pm3ds_null_segment);
PROVIDE(effect_star_spirits_energy_VRAM = pm3ds_null_segment);
PROVIDE(effect_stars_burst_ROM_END = pm3ds_null_segment);
PROVIDE(effect_stars_burst_ROM_START = pm3ds_null_segment);
PROVIDE(effect_stars_burst_VRAM = pm3ds_null_segment);
PROVIDE(effect_stars_orbiting_ROM_END = pm3ds_null_segment);
PROVIDE(effect_stars_orbiting_ROM_START = pm3ds_null_segment);
PROVIDE(effect_stars_orbiting_VRAM = pm3ds_null_segment);
PROVIDE(effect_stars_shimmer_ROM_END = pm3ds_null_segment);
PROVIDE(effect_stars_shimmer_ROM_START = pm3ds_null_segment);
PROVIDE(effect_stars_shimmer_VRAM = pm3ds_null_segment);
PROVIDE(effect_stars_spread_ROM_END = pm3ds_null_segment);
PROVIDE(effect_stars_spread_ROM_START = pm3ds_null_segment);
PROVIDE(effect_stars_spread_VRAM = pm3ds_null_segment);
PROVIDE(effect_stat_change_ROM_END = pm3ds_null_segment);
PROVIDE(effect_stat_change_ROM_START = pm3ds_null_segment);
PROVIDE(effect_stat_change_VRAM = pm3ds_null_segment);
PROVIDE(effect_static_status_ROM_END = pm3ds_null_segment);
PROVIDE(effect_static_status_ROM_START = pm3ds_null_segment);
PROVIDE(effect_static_status_VRAM = pm3ds_null_segment);
PROVIDE(effect_steam_burst_ROM_END = pm3ds_null_segment);
PROVIDE(effect_steam_burst_ROM_START = pm3ds_null_segment);
PROVIDE(effect_steam_burst_VRAM = pm3ds_null_segment);
PROVIDE(effect_stop_watch_ROM_END = pm3ds_null_segment);
PROVIDE(effect_stop_watch_ROM_START = pm3ds_null_segment);
PROVIDE(effect_stop_watch_VRAM = pm3ds_null_segment);
PROVIDE(effect_sun_ROM_END = pm3ds_null_segment);
PROVIDE(effect_sun_ROM_START = pm3ds_null_segment);
PROVIDE(effect_sun_VRAM = pm3ds_null_segment);
PROVIDE(effect_sweat_ROM_END = pm3ds_null_segment);
PROVIDE(effect_sweat_ROM_START = pm3ds_null_segment);
PROVIDE(effect_sweat_VRAM = pm3ds_null_segment);
PROVIDE(effect_tattle_window_ROM_END = pm3ds_null_segment);
PROVIDE(effect_tattle_window_ROM_START = pm3ds_null_segment);
PROVIDE(effect_tattle_window_VRAM = pm3ds_null_segment);
PROVIDE(effect_throw_spiny_ROM_END = pm3ds_null_segment);
PROVIDE(effect_throw_spiny_ROM_START = pm3ds_null_segment);
PROVIDE(effect_throw_spiny_VRAM = pm3ds_null_segment);
PROVIDE(effect_thunderbolt_ring_ROM_END = pm3ds_null_segment);
PROVIDE(effect_thunderbolt_ring_ROM_START = pm3ds_null_segment);
PROVIDE(effect_thunderbolt_ring_VRAM = pm3ds_null_segment);
PROVIDE(effect_tubba_heart_attack_ROM_END = pm3ds_null_segment);
PROVIDE(effect_tubba_heart_attack_ROM_START = pm3ds_null_segment);
PROVIDE(effect_tubba_heart_attack_VRAM = pm3ds_null_segment);
PROVIDE(effect_underwater_ROM_END = pm3ds_null_segment);
PROVIDE(effect_underwater_ROM_START = pm3ds_null_segment);
PROVIDE(effect_underwater_VRAM = pm3ds_null_segment);
PROVIDE(effect_walking_dust_ROM_END = pm3ds_null_segment);
PROVIDE(effect_walking_dust_ROM_START = pm3ds_null_segment);
PROVIDE(effect_walking_dust_VRAM = pm3ds_null_segment);
PROVIDE(effect_water_block_ROM_END = pm3ds_null_segment);
PROVIDE(effect_water_block_ROM_START = pm3ds_null_segment);
PROVIDE(effect_water_block_VRAM = pm3ds_null_segment);
PROVIDE(effect_water_fountain_ROM_END = pm3ds_null_segment);
PROVIDE(effect_water_fountain_ROM_START = pm3ds_null_segment);
PROVIDE(effect_water_fountain_VRAM = pm3ds_null_segment);
PROVIDE(effect_water_splash_ROM_END = pm3ds_null_segment);
PROVIDE(effect_water_splash_ROM_START = pm3ds_null_segment);
PROVIDE(effect_water_splash_VRAM = pm3ds_null_segment);
PROVIDE(effect_waterfall_ROM_END = pm3ds_null_segment);
PROVIDE(effect_waterfall_ROM_START = pm3ds_null_segment);
PROVIDE(effect_waterfall_VRAM = pm3ds_null_segment);
PROVIDE(effect_whirlwind_ROM_END = pm3ds_null_segment);
PROVIDE(effect_whirlwind_ROM_START = pm3ds_null_segment);
PROVIDE(effect_whirlwind_VRAM = pm3ds_null_segment);
PROVIDE(effect_windy_leaves_ROM_END = pm3ds_null_segment);
PROVIDE(effect_windy_leaves_ROM_START = pm3ds_null_segment);
PROVIDE(effect_windy_leaves_VRAM = pm3ds_null_segment);
PROVIDE(entity_default_ROM_END = pm3ds_null_segment);
PROVIDE(entity_default_ROM_START = pm3ds_null_segment);
PROVIDE(entity_default_VRAM = pm3ds_null_segment);
PROVIDE(entity_jan_iwa_ROM_END = pm3ds_null_segment);
PROVIDE(entity_jan_iwa_ROM_START = pm3ds_null_segment);
PROVIDE(entity_jan_iwa_VRAM = pm3ds_null_segment);
PROVIDE(entity_model_ArrowSign_ROM_END = pm3ds_null_segment);
PROVIDE(entity_model_ArrowSign_ROM_START = pm3ds_null_segment);
PROVIDE(entity_model_BellbellPlant_anim_ROM_END = pm3ds_null_segment);
PROVIDE(entity_model_BellbellPlant_anim_ROM_START = pm3ds_null_segment);
PROVIDE(entity_model_BellbellPlant_gfx_ROM_END = pm3ds_null_segment);
PROVIDE(entity_model_BellbellPlant_gfx_ROM_START = pm3ds_null_segment);
PROVIDE(entity_model_BlueSwitch_ROM_END = pm3ds_null_segment);
PROVIDE(entity_model_BlueSwitch_ROM_START = pm3ds_null_segment);
PROVIDE(entity_model_BlueWarpPipe_ROM_END = pm3ds_null_segment);
PROVIDE(entity_model_BlueWarpPipe_ROM_START = pm3ds_null_segment);
PROVIDE(entity_model_BoardedFloor_ROM_END = pm3ds_null_segment);
PROVIDE(entity_model_BoardedFloor_ROM_START = pm3ds_null_segment);
PROVIDE(entity_model_BombableRock_ROM_END = pm3ds_null_segment);
PROVIDE(entity_model_BombableRock_ROM_START = pm3ds_null_segment);
PROVIDE(entity_model_BrickBlock_ROM_END = pm3ds_null_segment);
PROVIDE(entity_model_BrickBlock_ROM_START = pm3ds_null_segment);
PROVIDE(entity_model_Chest_ROM_END = pm3ds_null_segment);
PROVIDE(entity_model_Chest_ROM_START = pm3ds_null_segment);
PROVIDE(entity_model_CymbalPlant_anim_ROM_END = pm3ds_null_segment);
PROVIDE(entity_model_CymbalPlant_anim_ROM_START = pm3ds_null_segment);
PROVIDE(entity_model_CymbalPlant_gfx_ROM_END = pm3ds_null_segment);
PROVIDE(entity_model_CymbalPlant_gfx_ROM_START = pm3ds_null_segment);
PROVIDE(entity_model_GreenStompSwitch_ROM_END = pm3ds_null_segment);
PROVIDE(entity_model_GreenStompSwitch_ROM_START = pm3ds_null_segment);
PROVIDE(entity_model_Hammer1Block_ROM_END = pm3ds_null_segment);
PROVIDE(entity_model_Hammer1Block_ROM_START = pm3ds_null_segment);
PROVIDE(entity_model_Hammer2Block_ROM_END = pm3ds_null_segment);
PROVIDE(entity_model_Hammer2Block_ROM_START = pm3ds_null_segment);
PROVIDE(entity_model_Hammer3Block_ROM_END = pm3ds_null_segment);
PROVIDE(entity_model_Hammer3Block_ROM_START = pm3ds_null_segment);
PROVIDE(entity_model_HeartBlockContent_ROM_END = pm3ds_null_segment);
PROVIDE(entity_model_HeartBlockContent_ROM_START = pm3ds_null_segment);
PROVIDE(entity_model_HeartBlock_ROM_END = pm3ds_null_segment);
PROVIDE(entity_model_HeartBlock_ROM_START = pm3ds_null_segment);
PROVIDE(entity_model_HiddenPanel_ROM_END = pm3ds_null_segment);
PROVIDE(entity_model_HiddenPanel_ROM_START = pm3ds_null_segment);
PROVIDE(entity_model_HitFloatingYellowBlock_anim_ROM_END = pm3ds_null_segment);
PROVIDE(entity_model_HitFloatingYellowBlock_anim_ROM_START = pm3ds_null_segment);
PROVIDE(entity_model_HitFloatingYellowBlock_gfx_ROM_END = pm3ds_null_segment);
PROVIDE(entity_model_HitFloatingYellowBlock_gfx_ROM_START = pm3ds_null_segment);
PROVIDE(entity_model_HitRedBlock_anim_ROM_END = pm3ds_null_segment);
PROVIDE(entity_model_HitRedBlock_anim_ROM_START = pm3ds_null_segment);
PROVIDE(entity_model_HitRedBlock_gfx_ROM_END = pm3ds_null_segment);
PROVIDE(entity_model_HitRedBlock_gfx_ROM_START = pm3ds_null_segment);
PROVIDE(entity_model_HitYellowBlock_anim_ROM_END = pm3ds_null_segment);
PROVIDE(entity_model_HitYellowBlock_anim_ROM_START = pm3ds_null_segment);
PROVIDE(entity_model_HitYellowBlock_gfx_ROM_END = pm3ds_null_segment);
PROVIDE(entity_model_HitYellowBlock_gfx_ROM_START = pm3ds_null_segment);
PROVIDE(entity_model_InertRedBlock_ROM_END = pm3ds_null_segment);
PROVIDE(entity_model_InertRedBlock_ROM_START = pm3ds_null_segment);
PROVIDE(entity_model_InertYellowBlock_ROM_END = pm3ds_null_segment);
PROVIDE(entity_model_InertYellowBlock_ROM_START = pm3ds_null_segment);
PROVIDE(entity_model_MunchlesiaBeginChew_anim_ROM_END = pm3ds_null_segment);
PROVIDE(entity_model_MunchlesiaBeginChew_anim_ROM_START = pm3ds_null_segment);
PROVIDE(entity_model_MunchlesiaBeginChew_gfx_ROM_END = pm3ds_null_segment);
PROVIDE(entity_model_MunchlesiaBeginChew_gfx_ROM_START = pm3ds_null_segment);
PROVIDE(entity_model_MunchlesiaChewing_anim_ROM_END = pm3ds_null_segment);
PROVIDE(entity_model_MunchlesiaChewing_anim_ROM_START = pm3ds_null_segment);
PROVIDE(entity_model_MunchlesiaChewing_gfx_ROM_END = pm3ds_null_segment);
PROVIDE(entity_model_MunchlesiaChewing_gfx_ROM_START = pm3ds_null_segment);
PROVIDE(entity_model_MunchlesiaEnvelop_anim_ROM_END = pm3ds_null_segment);
PROVIDE(entity_model_MunchlesiaEnvelop_anim_ROM_START = pm3ds_null_segment);
PROVIDE(entity_model_MunchlesiaEnvelop_gfx_ROM_END = pm3ds_null_segment);
PROVIDE(entity_model_MunchlesiaEnvelop_gfx_ROM_START = pm3ds_null_segment);
PROVIDE(entity_model_MunchlesiaGrab_anim_ROM_END = pm3ds_null_segment);
PROVIDE(entity_model_MunchlesiaGrab_anim_ROM_START = pm3ds_null_segment);
PROVIDE(entity_model_MunchlesiaGrab_gfx_ROM_END = pm3ds_null_segment);
PROVIDE(entity_model_MunchlesiaGrab_gfx_ROM_START = pm3ds_null_segment);
PROVIDE(entity_model_MunchlesiaReset1_anim_ROM_END = pm3ds_null_segment);
PROVIDE(entity_model_MunchlesiaReset1_anim_ROM_START = pm3ds_null_segment);
PROVIDE(entity_model_MunchlesiaReset1_gfx_ROM_END = pm3ds_null_segment);
PROVIDE(entity_model_MunchlesiaReset1_gfx_ROM_START = pm3ds_null_segment);
PROVIDE(entity_model_MunchlesiaReset_anim_ROM_END = pm3ds_null_segment);
PROVIDE(entity_model_MunchlesiaReset_anim_ROM_START = pm3ds_null_segment);
PROVIDE(entity_model_MunchlesiaReset_gfx_ROM_END = pm3ds_null_segment);
PROVIDE(entity_model_MunchlesiaReset_gfx_ROM_START = pm3ds_null_segment);
PROVIDE(entity_model_MunchlesiaSpitOut_anim_ROM_END = pm3ds_null_segment);
PROVIDE(entity_model_MunchlesiaSpitOut_anim_ROM_START = pm3ds_null_segment);
PROVIDE(entity_model_MunchlesiaSpitOut_gfx_ROM_END = pm3ds_null_segment);
PROVIDE(entity_model_MunchlesiaSpitOut_gfx_ROM_START = pm3ds_null_segment);
PROVIDE(entity_model_PadlockBlueFace_ROM_END = pm3ds_null_segment);
PROVIDE(entity_model_PadlockBlueFace_ROM_START = pm3ds_null_segment);
PROVIDE(entity_model_PadlockRedFace_ROM_END = pm3ds_null_segment);
PROVIDE(entity_model_PadlockRedFace_ROM_START = pm3ds_null_segment);
PROVIDE(entity_model_PadlockRedFrame_ROM_END = pm3ds_null_segment);
PROVIDE(entity_model_PadlockRedFrame_ROM_START = pm3ds_null_segment);
PROVIDE(entity_model_Padlock_ROM_END = pm3ds_null_segment);
PROVIDE(entity_model_Padlock_ROM_START = pm3ds_null_segment);
PROVIDE(entity_model_PinkFlower_anim_ROM_END = pm3ds_null_segment);
PROVIDE(entity_model_PinkFlower_anim_ROM_START = pm3ds_null_segment);
PROVIDE(entity_model_PinkFlower_gfx_ROM_END = pm3ds_null_segment);
PROVIDE(entity_model_PinkFlower_gfx_ROM_START = pm3ds_null_segment);
PROVIDE(entity_model_PowBlock_ROM_END = pm3ds_null_segment);
PROVIDE(entity_model_PowBlock_ROM_START = pm3ds_null_segment);
PROVIDE(entity_model_PushBlock_ROM_END = pm3ds_null_segment);
PROVIDE(entity_model_PushBlock_ROM_START = pm3ds_null_segment);
PROVIDE(entity_model_RedBlock_ROM_END = pm3ds_null_segment);
PROVIDE(entity_model_RedBlock_ROM_START = pm3ds_null_segment);
PROVIDE(entity_model_RedSwitch_ROM_END = pm3ds_null_segment);
PROVIDE(entity_model_RedSwitch_ROM_START = pm3ds_null_segment);
PROVIDE(entity_model_SaveBlock_ROM_END = pm3ds_null_segment);
PROVIDE(entity_model_SaveBlock_ROM_START = pm3ds_null_segment);
PROVIDE(entity_model_ScriptSpring_anim_ROM_END = pm3ds_null_segment);
PROVIDE(entity_model_ScriptSpring_anim_ROM_START = pm3ds_null_segment);
PROVIDE(entity_model_ScriptSpring_gfx_ROM_END = pm3ds_null_segment);
PROVIDE(entity_model_ScriptSpring_gfx_ROM_START = pm3ds_null_segment);
PROVIDE(entity_model_ShatteringBrickBlock_ROM_END = pm3ds_null_segment);
PROVIDE(entity_model_ShatteringBrickBlock_ROM_START = pm3ds_null_segment);
PROVIDE(entity_model_ShatteringHammer1Block_ROM_END = pm3ds_null_segment);
PROVIDE(entity_model_ShatteringHammer1Block_ROM_START = pm3ds_null_segment);
PROVIDE(entity_model_ShatteringHammer2Block_ROM_END = pm3ds_null_segment);
PROVIDE(entity_model_ShatteringHammer2Block_ROM_START = pm3ds_null_segment);
PROVIDE(entity_model_ShatteringHammer3Block_ROM_END = pm3ds_null_segment);
PROVIDE(entity_model_ShatteringHammer3Block_ROM_START = pm3ds_null_segment);
PROVIDE(entity_model_Signpost_ROM_END = pm3ds_null_segment);
PROVIDE(entity_model_Signpost_ROM_START = pm3ds_null_segment);
PROVIDE(entity_model_SimpleSpring_anim_ROM_END = pm3ds_null_segment);
PROVIDE(entity_model_SimpleSpring_anim_ROM_START = pm3ds_null_segment);
PROVIDE(entity_model_SimpleSpring_gfx_ROM_END = pm3ds_null_segment);
PROVIDE(entity_model_SimpleSpring_gfx_ROM_START = pm3ds_null_segment);
PROVIDE(entity_model_SpinningFlower_ROM_END = pm3ds_null_segment);
PROVIDE(entity_model_SpinningFlower_ROM_START = pm3ds_null_segment);
PROVIDE(entity_model_StarBoxLauncher_ROM_END = pm3ds_null_segment);
PROVIDE(entity_model_StarBoxLauncher_ROM_START = pm3ds_null_segment);
PROVIDE(entity_model_SuperBlockContent_ROM_END = pm3ds_null_segment);
PROVIDE(entity_model_SuperBlockContent_ROM_START = pm3ds_null_segment);
PROVIDE(entity_model_SuperBlock_ROM_END = pm3ds_null_segment);
PROVIDE(entity_model_SuperBlock_ROM_START = pm3ds_null_segment);
PROVIDE(entity_model_TrumpetPlant_anim_ROM_END = pm3ds_null_segment);
PROVIDE(entity_model_TrumpetPlant_anim_ROM_START = pm3ds_null_segment);
PROVIDE(entity_model_TrumpetPlant_gfx_ROM_END = pm3ds_null_segment);
PROVIDE(entity_model_TrumpetPlant_gfx_ROM_START = pm3ds_null_segment);
PROVIDE(entity_model_Tweester_ROM_END = pm3ds_null_segment);
PROVIDE(entity_model_Tweester_ROM_START = pm3ds_null_segment);
PROVIDE(entity_model_UltraBlockContent_ROM_END = pm3ds_null_segment);
PROVIDE(entity_model_UltraBlockContent_ROM_START = pm3ds_null_segment);
PROVIDE(entity_model_UltraBlock_ROM_END = pm3ds_null_segment);
PROVIDE(entity_model_UltraBlock_ROM_START = pm3ds_null_segment);
PROVIDE(entity_model_WoodenCrate_ROM_END = pm3ds_null_segment);
PROVIDE(entity_model_WoodenCrate_ROM_START = pm3ds_null_segment);
PROVIDE(entity_model_YellowBlock_ROM_END = pm3ds_null_segment);
PROVIDE(entity_model_YellowBlock_ROM_START = pm3ds_null_segment);
PROVIDE(entity_sbk_omo_ROM_END = pm3ds_null_segment);
PROVIDE(entity_sbk_omo_ROM_START = pm3ds_null_segment);
PROVIDE(entity_sbk_omo_VRAM = pm3ds_null_segment);
PROVIDE(sprite_shading_profiles_ROM_START = pm3ds_null_segment);
PROVIDE(sprite_shading_profiles_data_ROM_START = pm3ds_null_segment);
PROVIDE(title_bg_1_ROM_START = pm3ds_null_segment);
PROVIDE(world_model_anim_kzn_00_ROM_END = pm3ds_null_segment);
PROVIDE(world_model_anim_kzn_00_ROM_START = pm3ds_null_segment);
PROVIDE(world_model_anim_kzn_00_VRAM = pm3ds_null_segment);
PROVIDE(world_model_anim_kzn_01_ROM_END = pm3ds_null_segment);
PROVIDE(world_model_anim_kzn_01_ROM_START = pm3ds_null_segment);
PROVIDE(world_model_anim_kzn_01_VRAM = pm3ds_null_segment);
PROVIDE(world_model_anim_kzn_02_ROM_END = pm3ds_null_segment);
PROVIDE(world_model_anim_kzn_02_ROM_START = pm3ds_null_segment);
PROVIDE(world_model_anim_kzn_02_VRAM = pm3ds_null_segment);
PROVIDE(world_model_anim_kzn_03_ROM_END = pm3ds_null_segment);
PROVIDE(world_model_anim_kzn_03_ROM_START = pm3ds_null_segment);
PROVIDE(world_model_anim_kzn_03_VRAM = pm3ds_null_segment);
PROVIDE(world_model_anim_kzn_04_ROM_END = pm3ds_null_segment);
PROVIDE(world_model_anim_kzn_04_ROM_START = pm3ds_null_segment);
PROVIDE(world_model_anim_kzn_04_VRAM = pm3ds_null_segment);
PROVIDE(world_model_anim_kzn_05_ROM_END = pm3ds_null_segment);
PROVIDE(world_model_anim_kzn_05_ROM_START = pm3ds_null_segment);
PROVIDE(world_model_anim_kzn_05_VRAM = pm3ds_null_segment);
PROVIDE(world_model_anim_kzn_06_ROM_END = pm3ds_null_segment);
PROVIDE(world_model_anim_kzn_06_ROM_START = pm3ds_null_segment);
PROVIDE(world_model_anim_kzn_06_VRAM = pm3ds_null_segment);
PROVIDE(world_model_anim_kzn_07_ROM_END = pm3ds_null_segment);
PROVIDE(world_model_anim_kzn_07_ROM_START = pm3ds_null_segment);
PROVIDE(world_model_anim_kzn_07_VRAM = pm3ds_null_segment);
PROVIDE(world_model_anim_kzn_08_ROM_END = pm3ds_null_segment);
PROVIDE(world_model_anim_kzn_08_ROM_START = pm3ds_null_segment);
PROVIDE(world_model_anim_kzn_08_VRAM = pm3ds_null_segment);
PROVIDE(world_model_anim_kzn_09_ROM_END = pm3ds_null_segment);
PROVIDE(world_model_anim_kzn_09_ROM_START = pm3ds_null_segment);
PROVIDE(world_model_anim_kzn_09_VRAM = pm3ds_null_segment);
PROVIDE(world_model_anim_kzn_0A_ROM_END = pm3ds_null_segment);
PROVIDE(world_model_anim_kzn_0A_ROM_START = pm3ds_null_segment);
PROVIDE(world_model_anim_kzn_0A_VRAM = pm3ds_null_segment);
PROVIDE(world_model_anim_kzn_0B_ROM_END = pm3ds_null_segment);
PROVIDE(world_model_anim_kzn_0B_ROM_START = pm3ds_null_segment);
PROVIDE(world_model_anim_kzn_0B_VRAM = pm3ds_null_segment);
PROVIDE(world_model_anim_kzn_0C_ROM_END = pm3ds_null_segment);
PROVIDE(world_model_anim_kzn_0C_ROM_START = pm3ds_null_segment);
PROVIDE(world_model_anim_kzn_0C_VRAM = pm3ds_null_segment);
PROVIDE(world_model_anim_kzn_0D_ROM_END = pm3ds_null_segment);
PROVIDE(world_model_anim_kzn_0D_ROM_START = pm3ds_null_segment);
PROVIDE(world_model_anim_kzn_0D_VRAM = pm3ds_null_segment);
PROVIDE(world_model_anim_kzn_0E_ROM_END = pm3ds_null_segment);
PROVIDE(world_model_anim_kzn_0E_ROM_START = pm3ds_null_segment);
PROVIDE(world_model_anim_kzn_0E_VRAM = pm3ds_null_segment);
PROVIDE(world_model_anim_kzn_0F_ROM_END = pm3ds_null_segment);
PROVIDE(world_model_anim_kzn_0F_ROM_START = pm3ds_null_segment);
PROVIDE(world_model_anim_kzn_0F_VRAM = pm3ds_null_segment);
PROVIDE(world_model_anim_kzn_10_ROM_END = pm3ds_null_segment);
PROVIDE(world_model_anim_kzn_10_ROM_START = pm3ds_null_segment);
PROVIDE(world_model_anim_kzn_10_VRAM = pm3ds_null_segment);
PROVIDE(world_model_anim_kzn_11_ROM_END = pm3ds_null_segment);
PROVIDE(world_model_anim_kzn_11_ROM_START = pm3ds_null_segment);
PROVIDE(world_model_anim_kzn_11_VRAM = pm3ds_null_segment);
PROVIDE(world_model_anim_kzn_12_ROM_END = pm3ds_null_segment);
PROVIDE(world_model_anim_kzn_12_ROM_START = pm3ds_null_segment);
PROVIDE(world_model_anim_kzn_12_VRAM = pm3ds_null_segment);
PROVIDE(world_model_anim_kzn_13_ROM_END = pm3ds_null_segment);
PROVIDE(world_model_anim_kzn_13_ROM_START = pm3ds_null_segment);
PROVIDE(world_model_anim_kzn_13_VRAM = pm3ds_null_segment);
PROVIDE(world_model_anim_kzn_14_ROM_END = pm3ds_null_segment);
PROVIDE(world_model_anim_kzn_14_ROM_START = pm3ds_null_segment);
PROVIDE(world_model_anim_kzn_14_VRAM = pm3ds_null_segment);
PROVIDE(world_model_anim_kzn_15_ROM_END = pm3ds_null_segment);
PROVIDE(world_model_anim_kzn_15_ROM_START = pm3ds_null_segment);
PROVIDE(world_model_anim_kzn_15_VRAM = pm3ds_null_segment);
PROVIDE(world_model_anim_kzn_16_ROM_END = pm3ds_null_segment);
PROVIDE(world_model_anim_kzn_16_ROM_START = pm3ds_null_segment);
PROVIDE(world_model_anim_kzn_16_VRAM = pm3ds_null_segment);
PROVIDE(world_model_anim_kzn_17_ROM_END = pm3ds_null_segment);
PROVIDE(world_model_anim_kzn_17_ROM_START = pm3ds_null_segment);
PROVIDE(world_model_anim_kzn_17_VRAM = pm3ds_null_segment);
PROVIDE(world_model_anim_kzn_18_ROM_END = pm3ds_null_segment);
PROVIDE(world_model_anim_kzn_18_ROM_START = pm3ds_null_segment);
PROVIDE(world_model_anim_kzn_18_VRAM = pm3ds_null_segment);
PROVIDE(world_model_anim_kzn_19_ROM_END = pm3ds_null_segment);
PROVIDE(world_model_anim_kzn_19_ROM_START = pm3ds_null_segment);
PROVIDE(world_model_anim_kzn_19_VRAM = pm3ds_null_segment);
PROVIDE(world_model_anim_kzn_1A_ROM_END = pm3ds_null_segment);
PROVIDE(world_model_anim_kzn_1A_ROM_START = pm3ds_null_segment);
PROVIDE(world_model_anim_kzn_1A_VRAM = pm3ds_null_segment);
PROVIDE(world_model_anim_kzn_1B_ROM_END = pm3ds_null_segment);
PROVIDE(world_model_anim_kzn_1B_ROM_START = pm3ds_null_segment);
PROVIDE(world_model_anim_kzn_1B_VRAM = pm3ds_null_segment);
PROVIDE(world_model_anim_kzn_1C_ROM_END = pm3ds_null_segment);
PROVIDE(world_model_anim_kzn_1C_ROM_START = pm3ds_null_segment);
PROVIDE(world_model_anim_kzn_1C_VRAM = pm3ds_null_segment);
PROVIDE(world_model_anim_kzn_1D_ROM_END = pm3ds_null_segment);
PROVIDE(world_model_anim_kzn_1D_ROM_START = pm3ds_null_segment);
PROVIDE(world_model_anim_kzn_1D_VRAM = pm3ds_null_segment);
PROVIDE(world_model_anim_kzn_1E_ROM_END = pm3ds_null_segment);
PROVIDE(world_model_anim_kzn_1E_ROM_START = pm3ds_null_segment);
PROVIDE(world_model_anim_kzn_1E_VRAM = pm3ds_null_segment);
PROVIDE(world_model_anim_kzn_1F_ROM_END = pm3ds_null_segment);
PROVIDE(world_model_anim_kzn_1F_ROM_START = pm3ds_null_segment);
PROVIDE(world_model_anim_kzn_1F_VRAM = pm3ds_null_segment);
PROVIDE(world_model_anim_kzn_20_ROM_END = pm3ds_null_segment);
PROVIDE(world_model_anim_kzn_20_ROM_START = pm3ds_null_segment);
PROVIDE(world_model_anim_kzn_20_VRAM = pm3ds_null_segment);
PROVIDE(world_model_anim_kzn_21_ROM_END = pm3ds_null_segment);
PROVIDE(world_model_anim_kzn_21_ROM_START = pm3ds_null_segment);
PROVIDE(world_model_anim_kzn_21_VRAM = pm3ds_null_segment);
PROVIDE(world_model_anim_kzn_22_ROM_END = pm3ds_null_segment);
PROVIDE(world_model_anim_kzn_22_ROM_START = pm3ds_null_segment);
PROVIDE(world_model_anim_kzn_22_VRAM = pm3ds_null_segment);
PROVIDE(world_model_anim_kzn_23_ROM_END = pm3ds_null_segment);
PROVIDE(world_model_anim_kzn_23_ROM_START = pm3ds_null_segment);
PROVIDE(world_model_anim_kzn_23_VRAM = pm3ds_null_segment);
PROVIDE(world_model_anim_kzn_24_ROM_END = pm3ds_null_segment);
PROVIDE(world_model_anim_kzn_24_ROM_START = pm3ds_null_segment);
PROVIDE(world_model_anim_kzn_24_VRAM = pm3ds_null_segment);
